// SPDX-License-Identifier: (GPL-2.0+ OR MIT)
/*
 * Copyright (c) 2021 Rockchip Electronics Co., Ltd.
 *
 */

/dts-v1/;
#include <dt-bindings/gpio/gpio.h>
#include <dt-bindings/pinctrl/rockchip.h>
#include "rk3568.dtsi"

/ {
	model = "Firefly RK3566 Board";
	compatible = "firefly,firefly-rk3566", "rockchip,rk3566";

	chosen: chosen {
		stdout-path = "serial2:1500000n8";
	};
};

/*
&sdhci {
	bus-width = <8>;
	max-frequency = <200000000>;
	non-removable;
	status = "okay";
};
*/

&uart2 {
	status = "okay";
};
